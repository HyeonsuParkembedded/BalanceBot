## sdkconfig.defaults
```kconfig
# Bluetooth
CONFIG_BT_ENABLED=y
CONFIG_BT_BLUEDROID_ENABLED=y
CONFIG_BT_NIMBLE_ENABLED=n
CONFIG_BTDM_CTRL_MODE_BLE_ONLY=y
CONFIG_BTDM_CTRL_MODE_BR_EDR_ONLY=n
CONFIG_BTDM_CTRL_MODE_BTDM=n
CONFIG_BT_GATTS_ENABLE=y
CONFIG_BT_GATT_MAX_SR_PROFILES=8
CONFIG_BT_GATT_MAX_SR_ATTRIBUTES=100
CONFIG_BT_BLE_ENABLED=y
CONFIG_BT_CONTROLLER_ENABLED=y

# FreeRTOS
CONFIG_FREERTOS_HZ=1000

# Main task stack size
CONFIG_ESP_MAIN_TASK_STACK_SIZE=8192

# Component config
CONFIG_ESP_DEFAULT_CPU_FREQ_MHZ_240=y

# Serial flasher config
CONFIG_ESPTOOLPY_FLASHSIZE_4MB=y
```
